## drivers/net/avb/Kconfig
```kconfig
# SPDX-License-Identifier: GPL-2.0-only
#
# AVB driver configuration
#
config AVB
	tristate "AVB protocol stack support"
	select LLC
	---help---
	  This implemenattion of the AVB protocol stack allows to transmit tightly synchronous 	    audio data within an IEEE 802.3 network configured with AVB capable end-stations and
	  bridges.
	  To build all AVB protocol stack modules please choose "M" for module build or "Y" for 		  a static kernel build.
	  
	  
```

## drivers/net/gptp/Kconfig
```kconfig
config GPTP
	tristate "gPTP protocol support"
	---help---
	  This implemenattion of the IEEE 802.1AS protocol allows
	  for P2P time synchronization within a given network.
```
